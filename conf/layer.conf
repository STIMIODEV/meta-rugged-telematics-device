## conf/layer.conf
```bitbake
# We have a conf and classes directory, add to BBPATH
BBPATH .= ":${LAYERDIR}"

# We have recipes-* directories, add to BBFILES
BBFILES += "${LAYERDIR}/recipes-*/*/*.bb \
            ${LAYERDIR}/recipes-*/*/*.bbappend \
            ${LAYERDIR}/recipes-*/*/*/*.bb \
            ${LAYERDIR}/recipes-*/*/*/*.bbappend"

BBFILE_COLLECTIONS += "meta-telematics-device"
BBFILE_PATTERN_meta-telematics-device = "^${LAYERDIR}/"
BBFILE_PRIORITY_meta-telematics-device = "6"

LAYERDEPENDS_meta-telematics-device = "core"
LAYERSERIES_COMPAT_meta-telematics-device = "kirkstone"

SOC_DEFAULT_IMAGE_FSTYPES:remove = " wic.gz wic.bz2 tar.bz2"
SOC_DEFAULT_IMAGE_FSTYPES:append = " ext4 tar"
```

## conf/machine/imx6ull-iwg26i.conf
```bitbake
#@TYPE: Machine
#@NAME: Telematics Device
#@SOC: i.MX6ULL
#@DESCRIPTION: Machine configuration for Telematics Device
#@MAINTAINER: iWave Systems Technologies Pvt. Ltd. <support.obd@iwavesystems.com>

MACHINEOVERRIDES =. "mx6:mx6ul:mx6ull:"

include conf/machine/include/imx-base.inc
include conf/machine/include/arm/armv7a/tune-cortexa7.inc

IWG26I_KERNEL_DEFCONFIG = "imx6ull_iwg26i_defconfig"
KERNEL_IMAGETYPE_imx6ull-iwg26i = "zImage"
KERNEL_DEVICETREE = "imx6ull-iwg26i.dtb"

UBOOT_CONFIG ??= "sd"
UBOOT_CONFIG[sd] = "mx6ull_iwg26i_defconfig,sdcard"

MACHINE_FEATURES += "wifi bluetooth bcm4339 bcm43455"

IMAGE_FEATURES += "debug-tweaks"
PACKAGECONFIG:remove = "packagegroup-core-ssh-dropbear dropbear"
IMAGE_INSTALL:remove = "packagegroup-core-ssh-dropbear dropbear"
IMAGE_FEATURES:remove = "ssh-server-dropbear" 
EXTRA_IMAGE_FEATURES = "ssh-server-openssh"
OPTLEVEL:remove = "-O2"

MACHINE_ESSENTIAL_EXTRA_RDEPENDS="kernel-image kernel-devicetree "

# For initramfs
IMAGE_INSTALL:append = " \
	apt dpkg dhcpcd keyutils lvm2 e2fsprogs-mke2fs\
"
```
